## configs/duna_defconfig
```kconfig
BR2_mips=y
BR2_mips_32=y
BR2_OPTIMIZE_2=y
BR2_BINUTILS_VERSION_2_23_1=y
BR2_GCC_VERSION_4_8_X=y
BR2_TOOLCHAIN_BUILDROOT_LARGEFILE=y
BR2_TOOLCHAIN_BUILDROOT_INET_RPC=y
BR2_TOOLCHAIN_BUILDROOT_LOCALE=y
BR2_TOOLCHAIN_BUILDROOT_CXX=y
BR2_TARGET_GENERIC_HOSTNAME="opendingux"
BR2_TARGET_GENERIC_ISSUE="Welcome to OpenDingux"
BR2_ROOTFS_STATIC_DEVICE_TABLE="board/opendingux/mini_device_table.txt"
BR2_ROOTFS_SKELETON_CUSTOM=y
BR2_ROOTFS_SKELETON_CUSTOM_PATH="board/opendingux/a380/target_skeleton"
BR2_PACKAGE_BUSYBOX_CONFIG="board/opendingux/busybox-1.20.x.config"
BR2_PACKAGE_BUSYBOX_SHOW_OTHERS=y
BR2_PACKAGE_ALSA_UTILS=y
BR2_PACKAGE_ALSA_UTILS_ALSACONF=y
BR2_PACKAGE_ALSA_UTILS_AMIDI=y
BR2_PACKAGE_ALSA_UTILS_AMIXER=y
BR2_PACKAGE_ALSA_VOLUME=y
BR2_PACKAGE_FLAC=y
BR2_PACKAGE_MADPLAY=y
BR2_PACKAGE_MPG123=y
BR2_PACKAGE_DHRYSTONE=y
BR2_PACKAGE_DSTAT=y
BR2_PACKAGE_DMALLOC=y
BR2_PACKAGE_LMBENCH=y
BR2_PACKAGE_MEMSTAT=y
BR2_PACKAGE_NETPERF=y
BR2_PACKAGE_OPROFILE=y
BR2_PACKAGE_STRACE=y
BR2_PACKAGE_STRESS=y
BR2_PACKAGE_WHETSTONE=y
BR2_PACKAGE_SSTRIP=y
BR2_PACKAGE_ALLEGRO=y
BR2_PACKAGE_FBGRAB=y
BR2_PACKAGE_LIBMIKMOD=y
BR2_PACKAGE_SDL_IMAGE=y
BR2_PACKAGE_SDL_IMAGE_GIF=y
BR2_PACKAGE_SDL_IMAGE_JPEG=y
BR2_PACKAGE_SDL_IMAGE_LBM=y
BR2_PACKAGE_SDL_IMAGE_PCX=y
BR2_PACKAGE_SDL_IMAGE_PNG=y
BR2_PACKAGE_SDL_IMAGE_TARGA=y
BR2_PACKAGE_SDL_IMAGE_TIFF=y
BR2_PACKAGE_SDL_IMAGE_XCF=y
BR2_PACKAGE_SDL_MIXER=y
BR2_PACKAGE_SDL_SOUND=y
BR2_PACKAGE_SDL_NET=y
BR2_PACKAGE_TIMIDITY_INSTRUMENTS=y
BR2_PACKAGE_DEJAVU_FONTS_SANS=y
BR2_PACKAGE_DEJAVU_FONTS_SERIF=y
BR2_PACKAGE_MTD=y
BR2_PACKAGE_DINGOO_TVOUT=y
BR2_PACKAGE_FMTOOLS=y
BR2_PACKAGE_I2C_TOOLS=y
BR2_PACKAGE_PWSWD=y
BR2_PACKAGE_PWSWD_PLATFORM="gcw0"
BR2_PACKAGE_ALSA_LIB_DEVDIR="/dev"
# BR2_PACKAGE_ALSA_LIB_ALISP is not set
# BR2_PACKAGE_ALSA_LIB_OLD_SYMBOLS is not set
BR2_PACKAGE_LIBAO=y
BR2_PACKAGE_LIBSNDFILE=y
BR2_PACKAGE_SPEEX=y
BR2_PACKAGE_TAGLIB=y
BR2_PACKAGE_TAGLIB_MP4=y
BR2_PACKAGE_TAGLIB_ASF=y
BR2_PACKAGE_TREMOR=y
BR2_PACKAGE_LZO=y
BR2_PACKAGE_LIBGCRYPT=y
BR2_PACKAGE_SQLITE=y
BR2_PACKAGE_LIBCONFUSE=y
BR2_PACKAGE_LIBOPK=y
BR2_PACKAGE_LIBSYSFS=y
BR2_PACKAGE_LIBUNGIF=y
BR2_PACKAGE_LIBTHEORA=y
BR2_PACKAGE_NEWT=y
BR2_PACKAGE_READLINE=y
BR2_PACKAGE_EXPAT=y
BR2_PACKAGE_LIBXML2=y
BR2_PACKAGE_GMENU2X=y
BR2_PACKAGE_GMENU2X_PLATFORM="a320"
BR2_PACKAGE_PYCLOCK=y
BR2_PACKAGE_DROPBEAR=y
BR2_PACKAGE_NETCAT=y
BR2_PACKAGE_OPENSSH=y
# BR2_PACKAGE_OPENSSH_START_DAEMON is not set
BR2_PACKAGE_DIALOG=y
BR2_PACKAGE_FILE=y
BR2_PACKAGE_LOCKFILE_PROGS=y
BR2_PACKAGE_BWM_NG=y
BR2_PACKAGE_DINGUX_COMMANDER=y
BR2_PACKAGE_HTOP=y
BR2_PACKAGE_NANO=y
BR2_PACKAGE_VIM=y
BR2_TARGET_ROOTFS_EXT2=y
# BR2_TARGET_ROOTFS_TAR is not set
```
